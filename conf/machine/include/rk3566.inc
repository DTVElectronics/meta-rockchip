## conf/machine/include/rk3566.inc
```bitbake
require conf/machine/include/rk356x.inc

SOC_FAMILY = "rk3566"
MACHINEOVERRIDES =. "rk3566:"
```

## conf/machine/include/rk3588.inc
```bitbake
# Copyright (c) 2021, Rockchip Electronics Co., Ltd
# Released under the MIT license (see COPYING.MIT for the terms)

SOC_FAMILY ?= "rk3588"
PREFERRED_VERSION_linux-rockchip ?= "6.1%"
LINUXLIBCVERSION ?= "6.1-custom%"

DEFAULTTUNE ?= "cortexa76-cortexa55-crypto"

require conf/machine/include/soc-family.inc
require conf/machine/include/arm/armv8-2a/tune-cortexa76-cortexa55.inc
require conf/machine/include/rockchip-defaults.inc
require conf/machine/include/rockchip-wic.inc

KBUILD_DEFCONFIG = "rk3588_linux_defconfig"

MALI_GPU := "valhall-g610"
MALI_VERSION ?= "g6p0"

RK_ISP_VERSION := "3.0"
```

## conf/machine/radxa-cm3-rpi-cm4-io.conf
```bitbake
#@TYPE: Machine
#@NAME: Radxa CM3 IO
#@DESCRIPTION: Radxa CM3 IO Board is an application board for the Radxa CM3 with rich IO features.
#https://docs.radxa.com/compute-module/cm3
#https://docs.radxa.com/accessories/cm3-io-board

require conf/machine/include/rk3566.inc

KERNEL_DEVICETREE = "rockchip/rk3566-radxa-cm3-rpi-cm4-io.dtb"
MACHINE_EXTRA_RRECOMMENDS += "kernel-modules"

UBOOT_MACHINE = "radxa-cm3-io-rk3566_defconfig"
```

## conf/machine/rockchip-rk3566-radxa-cm3-io.conf
```bitbake
# Copyright (c) 2022, Radxa Ltd
# Released under the MIT license (see COPYING.MIT for the terms)

#@TYPE: Machine
#@NAME: RK3566 Radxa CM3 IO

require conf/machine/include/rk3566.inc

KERNEL_DEVICETREE = "rockchip/rk3566-radxa-cm3-rpi-cm4-io.dtb"

UBOOT_MACHINE = "radxa-cm3-io-rk3566_defconfig"

IMAGE_INSTALL:append = " \
	kernel-modules \
"
```

## conf/machine/rockchip-rk3588s-radxa-cm5-rpi-cm4-io.conf
```bitbake
# Copyright (c) 2022, Radxa Ltd
# Released under the MIT license (see COPYING.MIT for the terms)

#@TYPE: Machine
#@NAME: RK3588S ROCK 5A

require conf/machine/include/rk3588.inc

KERNEL_DEVICETREE = "rockchip/rk3588s-radxa-cm5-rpi-cm4-io.dtb"

UBOOT_MACHINE = "radxa-cm5-rpi-cm4-io-rk3588s_defconfig"

IMAGE_INSTALL:append = " \
	kernel-modules \
"
```
